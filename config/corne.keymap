/*
* Copyright (c) 2020 The ZMK Contributors
*
* SPDX-License-Identifier: MIT
*/

#include <behaviors.dtsi>
#include <dt-bindings/zmk/keys.h>
#include <dt-bindings/zmk/bt.h>
#include <dt-bindings/zmk/rgb.h>
#include <dt-bindings/zmk/outputs.h>
#include <dt-bindings/zmk/ext_power.h>

#include "corne.h"




/ {
    keymap {
        compatible = "zmk,keymap";
        #define MIRYOKU_X(LAYER, STRING) \
             LAYER { \
             display-name = STRING; \
             bindings = <MIRYOKU_LAYER_##LAYER>; \
        };
        MIRYOKU_LAYER_LIST
        #undef MIRYOKU_X
    };
};

#include "behaviors.dtsi"
#include "dtap_guard.dtsi"
#include "shift_functions.dtsi"
